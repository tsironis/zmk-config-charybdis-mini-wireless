## config/west.yml
```yaml
manifest:
  remotes:
    - name: zmkfirmware
      url-base: https://github.com/zmkfirmware
    - name: tsironis
      url-base: https://github.com/tsironis

  projects:
    - name: zmk
      remote: zmkfirmware
      revision: 4dd95d7840eb3d5a3f59bb29fbf1ab054715ef85  # 2026-10-09, includes PR #3110 split input deadlock fix
      import: app/west.yml
    - name: zmk-pmw3610-driver
      remote: tsironis
      revision: main

  self:
    path: config
```
